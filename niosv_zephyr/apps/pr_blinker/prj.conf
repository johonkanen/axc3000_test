## CMakeLists.txt
```
# SPDX-License-Identifier: Apache-2.0
#
# The partial reconfiguration demo app, for the PR_DEMO hardware
# (PR_DEMO=1 hw/build_all.sh + hw/pr/build_personas.sh): swaps the LED
# blinker region between its two personas - blue and green - every few
# seconds, both persona bitstreams built into the app. Otherwise smp_app:
# runs from the HyperRAM under MCUboot, takes app and bitstream updates over
# mcumgr on the 12 MBaud FTDI UART.
#
#   west build -b niosv_g -d build_pr_blinker ../apps/pr_blinker -- -DAPP_VERSION=2.0.0
#     [-DPR_HW=<dir with output_files/, default ../hw>] [-DPR_PERIOD_MS=3000]
#   ../mcuboot/sign_app.sh build_pr_blinker 2.0.0

cmake_minimum_required(VERSION 3.20.0)

set(NIOSV_ZEPHYR ${CMAKE_CURRENT_LIST_DIR}/../..)
include(${CMAKE_CURRENT_LIST_DIR}/../niosv_cpu_clock.cmake)
list(APPEND EXTRA_DTC_OVERLAY_FILE
     ${NIOSV_ZEPHYR}/zephyr_overlays/niosv_g_hyperram_xip.overlay
     ${NIOSV_ZEPHYR}/zephyr_overlays/niosv_g_uart_fifo.overlay
     ${NIOSV_ZEPHYR}/zephyr_overlays/niosv_g_sdm_qspi.overlay
     ${NIOSV_ZEPHYR}/zephyr_overlays/niosv_g_flash_layout.overlay
     ${NIOSV_ZEPHYR}/zephyr_overlays/niosv_g_bootinfo.overlay
     ${NIOSV_ZEPHYR}/zephyr_overlays/niosv_g_pr.overlay
     ${CMAKE_CURRENT_LIST_DIR}/app.overlay)
list(APPEND EXTRA_CONF_FILE ${NIOSV_ZEPHYR}/mcuboot/app_ram_load.conf)

if(NOT DEFINED APP_VERSION)
  set(APP_VERSION 0.0.0)
endif()
if(NOT DEFINED PR_HW)
  set(PR_HW ${NIOSV_ZEPHYR}/hw)
endif()
if(NOT DEFINED PR_PERIOD_MS)
  set(PR_PERIOD_MS 3000)
endif()
# the personas of that hardware's base revision: they only load into it
get_filename_component(PR_HW ${PR_HW} ABSOLUTE BASE_DIR $ENV{PWD})
set(PERSONA_BLUE  ${PR_HW}/output_files/niosv_zephyr.blinker.rbf)
set(PERSONA_GREEN ${PR_HW}/output_files/impl_green.blinker.rbf)
foreach(f ${PERSONA_BLUE} ${PERSONA_GREEN})
  if(NOT EXISTS ${f})
    message(FATAL_ERROR "${f} missing: PR_DEMO=1 ./build_all.sh and pr/build_personas.sh in ${PR_HW}")
  endif()
endforeach()

find_package(Zephyr REQUIRED HINTS $ENV{ZEPHYR_BASE})
project(pr_blinker)

target_sources(app PRIVATE src/main.c src/personas.S)
target_compile_definitions(app PRIVATE APP_VERSION="${APP_VERSION}" PR_PERIOD_MS=${PR_PERIOD_MS}
  PERSONA_BLUE="${PERSONA_BLUE}" PERSONA_GREEN="${PERSONA_GREEN}")
# rebuild when a persona changes
set_property(SOURCE src/personas.S APPEND PROPERTY OBJECT_DEPENDS ${PERSONA_BLUE} ${PERSONA_GREEN})
```

## prj.conf
```kconfig
CONFIG_PRINTK=y
CONFIG_SYS_HEAP_AUTO=y

# mcumgr / SMP over uart1 (the FTDI UART)
CONFIG_MCUMGR=y
CONFIG_NET_BUF=y
CONFIG_ZCBOR=y
CONFIG_CRC=y
CONFIG_BASE64=y
CONFIG_SERIAL=y
CONFIG_UART_INTERRUPT_DRIVEN=y
CONFIG_UART_MCUMGR=y
CONFIG_MCUMGR_TRANSPORT_UART=y
# large frames: the host uses smpmgr --line-length 4096 --line-buffers 4,
# which makes ~12 KB frames - a frame larger than the net_buf is dropped
# silently (the upload then times out), so 16 KB, as MCUboot's
CONFIG_MCUMGR_TRANSPORT_UART_MTU=16384
CONFIG_MCUMGR_TRANSPORT_NETBUF_SIZE=16384
CONFIG_UART_MCUMGR_RX_BUF_SIZE=4096
# one per line of a frame (smpmgr --line-buffers 4); fewer drop fragments
CONFIG_UART_MCUMGR_RX_BUF_COUNT=4
CONFIG_SYSTEM_WORKQUEUE_STACK_SIZE=4096
CONFIG_MAIN_STACK_SIZE=2048

# image upload into the QSPI flash slots, reset
CONFIG_FLASH=y
CONFIG_FLASH_MAP=y
CONFIG_STREAM_FLASH=y
CONFIG_IMG_MANAGER=y
# erase as the image arrives, not the whole 4 MB slot before the first reply
CONFIG_IMG_ERASE_PROGRESSIVELY=y
CONFIG_MCUMGR_GRP_IMG=y
CONFIG_MCUMGR_GRP_OS=y
CONFIG_REBOOT=y

# which slot MCUboot loaded (RAM-load), from niosv_g_bootinfo.overlay
CONFIG_RETAINED_MEM=y
CONFIG_RETENTION=y
CONFIG_RETAINED_MEM_ZEPHYR_RAM=y
CONFIG_RETENTION_BOOTLOADER_INFO=y
CONFIG_RETENTION_BOOTLOADER_INFO_TYPE_MCUBOOT=y

# warnings on the JTAG console (e.g. uart_mcumgr dropping fragments)
CONFIG_LOG=y

# FPGA bitstream updates too (zephyr_module rsu_mgmt, mcuboot/update_bitstream.py)
CONFIG_AXC3000_LIBRSU=y
CONFIG_AXC3000_RSU_MGMT=y
CONFIG_COMMON_LIBC_MALLOC_ARENA_SIZE=65536
# libRSU keeps two 4 KB blocks on the stack of mcumgr's worker
CONFIG_MCUMGR_TRANSPORT_WORKQUEUE_STACK_SIZE=16384

# swaps the personas itself: no PR over mcumgr (two at once would collide)
CONFIG_AXC3000_PR_MGMT=n
```

## src/main.c
```c
/* The partial reconfiguration demo: swaps the PR region between the blue
 * and the green LED blinker persona every PR_PERIOD_MS, while the rest of
 * the FPGA - this CPU, the HyperRAM it runs from, mcumgr on the UART - keeps
 * running.
 */
#include <zephyr/kernel.h>
#include <axc3000/pr.h>

extern const uint8_t persona_blue[], persona_blue_end[];
extern const uint8_t persona_green[], persona_green_end[];

struct persona {
	const char *name;
	const uint8_t *start, *end;
};

static const struct persona personas[] = {
	{"green", persona_green, persona_green_end},
	{"blue", persona_blue, persona_blue_end},
};

int main(void)
{
	printk("pr_blinker %s: swapping personas every %d ms\n", APP_VERSION, PR_PERIOD_MS);

	for (unsigned int n = 0;; n++) {
		const struct persona *p = &personas[n % ARRAY_SIZE(personas)];
		size_t len = p->end - p->start;
		int64_t t0 = k_uptime_get();
		uint32_t status;
		enum axc3000_pr_step step = axc3000_pr_program(p->start, len, &status);

		if (step != AXC3000_PR_OK) {
			printk("pr_blinker: %s failed (step %d, status %u) - stopping\n",
			       p->name, step, status);
			break;
		}
		printk("pr_blinker: %s (%zu bytes) in %lld ms\n", p->name, len,
		       k_uptime_get() - t0);
		k_msleep(PR_PERIOD_MS);
	}
	return 0;
}
```
