## CMakeLists.txt
```
# SPDX-License-Identifier: Apache-2.0
#
# The updatable application: runs from the HyperRAM under MCUboot (RAM-load),
# and takes new images over the 12 MBaud FTDI UART (mcumgr / SMP server):
# upload into a flash slot, then reset - MCUboot boots the newer version.
#
#   west build -b niosv_g -d build_smp_app ../apps/smp_app -- -DAPP_VERSION=1.0.0
#   ../mcuboot/sign_app.sh build_smp_app 1.0.0
#   then: smpmgr --port /dev/ttyUSB0 --baudrate 12000000 ... upgrade zephyr.signed.bin

cmake_minimum_required(VERSION 3.20.0)

set(NIOSV_ZEPHYR ${CMAKE_CURRENT_LIST_DIR}/../..)
include(${CMAKE_CURRENT_LIST_DIR}/../niosv_cpu_clock.cmake)
# -DSMALL_OCRAM=1: the small on-chip RAM hardware variant (68 KB ram0, an 8
# KB data cache; hw_a065dc) - all of the application's memory in the HyperRAM
if(SMALL_OCRAM)
  set(XIP_OVERLAY niosv_g_hyperram_xip_small)
  set(BOOTINFO_OVERLAY niosv_g_bootinfo_small)
else()
  set(XIP_OVERLAY niosv_g_hyperram_xip)
  set(BOOTINFO_OVERLAY niosv_g_bootinfo)
endif()
list(APPEND EXTRA_DTC_OVERLAY_FILE
     ${NIOSV_ZEPHYR}/zephyr_overlays/${XIP_OVERLAY}.overlay
     ${NIOSV_ZEPHYR}/zephyr_overlays/niosv_g_uart_fifo.overlay
     ${NIOSV_ZEPHYR}/zephyr_overlays/niosv_g_sdm_qspi.overlay
     ${NIOSV_ZEPHYR}/zephyr_overlays/niosv_g_flash_layout.overlay
     ${NIOSV_ZEPHYR}/zephyr_overlays/${BOOTINFO_OVERLAY}.overlay
     ${CMAKE_CURRENT_LIST_DIR}/app.overlay)
# -DPR_DEMO=1: the partial reconfiguration demo hardware (PR_DEMO=1
# hw/build_all.sh) - persona programming over mcumgr (rsu_mgmt command 4)
if(PR_DEMO)
  list(APPEND EXTRA_DTC_OVERLAY_FILE ${NIOSV_ZEPHYR}/zephyr_overlays/niosv_g_pr.overlay)
endif()
list(APPEND EXTRA_CONF_FILE ${NIOSV_ZEPHYR}/mcuboot/app_ram_load.conf)
if(SMALL_OCRAM)
  list(APPEND EXTRA_CONF_FILE ${NIOSV_ZEPHYR}/zephyr_overlays/niosv_g_small_ocram.conf)
endif()

if(NOT DEFINED APP_VERSION)
  set(APP_VERSION 0.0.0)
endif()

find_package(Zephyr REQUIRED HINTS $ENV{ZEPHYR_BASE})
project(smp_app)

target_sources(app PRIVATE src/main.c)
target_compile_definitions(app PRIVATE APP_VERSION="${APP_VERSION}")
```

## prj.conf
```kconfig
CONFIG_PRINTK=y
CONFIG_SYS_HEAP_AUTO=y

# mcumgr / SMP over uart1 (the FTDI UART)
CONFIG_MCUMGR=y
CONFIG_NET_BUF=y
CONFIG_ZCBOR=y
CONFIG_CRC=y
CONFIG_BASE64=y
CONFIG_SERIAL=y
CONFIG_UART_INTERRUPT_DRIVEN=y
CONFIG_UART_MCUMGR=y
CONFIG_MCUMGR_TRANSPORT_UART=y
# large frames: the host uses smpmgr --line-length 4096 --line-buffers 4,
# which makes ~12 KB frames - a frame larger than the net_buf is dropped
# silently (the upload then times out), so 16 KB, as MCUboot's
CONFIG_MCUMGR_TRANSPORT_UART_MTU=16384
CONFIG_MCUMGR_TRANSPORT_NETBUF_SIZE=16384
CONFIG_UART_MCUMGR_RX_BUF_SIZE=4096
# one per line of a frame (smpmgr --line-buffers 4); fewer drop fragments
CONFIG_UART_MCUMGR_RX_BUF_COUNT=4
CONFIG_SYSTEM_WORKQUEUE_STACK_SIZE=4096
CONFIG_MAIN_STACK_SIZE=2048

# image upload into the QSPI flash slots, reset
CONFIG_FLASH=y
CONFIG_FLASH_MAP=y
CONFIG_STREAM_FLASH=y
CONFIG_IMG_MANAGER=y
# erase as the image arrives, not the whole 4 MB slot before the first reply
CONFIG_IMG_ERASE_PROGRESSIVELY=y
CONFIG_MCUMGR_GRP_IMG=y
CONFIG_MCUMGR_GRP_OS=y
CONFIG_REBOOT=y

# which slot MCUboot loaded (RAM-load), from niosv_g_bootinfo.overlay
CONFIG_RETAINED_MEM=y
CONFIG_RETENTION=y
CONFIG_RETAINED_MEM_ZEPHYR_RAM=y
CONFIG_RETENTION_BOOTLOADER_INFO=y
CONFIG_RETENTION_BOOTLOADER_INFO_TYPE_MCUBOOT=y

# warnings on the JTAG console (e.g. uart_mcumgr dropping fragments)
CONFIG_LOG=y

# FPGA bitstream updates too (zephyr_module rsu_mgmt, mcuboot/update_bitstream.py)
CONFIG_AXC3000_LIBRSU=y
CONFIG_AXC3000_RSU_MGMT=y
CONFIG_COMMON_LIBC_MALLOC_ARENA_SIZE=65536
# libRSU keeps two 4 KB blocks on the stack of mcumgr's worker
CONFIG_MCUMGR_TRANSPORT_WORKQUEUE_STACK_SIZE=16384
```

## app.overlay
```dts
/ {
	chosen {
		zephyr,uart-mcumgr = &uart1;
	};
};
```

## src/main.c
```c
/* The updatable application: prints its version, and serves mcumgr (SMP) on
 * the FTDI UART - image upload into the QSPI flash slots, reset. Reset is a
 * reconfiguration from the running bitstream (zephyr_module), which brings
 * MCUboot back; MCUboot then RAM-loads the newer of the two slots.
 */
#include <zephyr/kernel.h>

int main(void)
{
	for (int n = 0;; n++) {
		printk("smp_app %s running (%d)\n", APP_VERSION, n);
		k_msleep(2000);
	}
	return 0;
}
```
