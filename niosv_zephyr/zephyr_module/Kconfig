## niosv_zephyr/zephyr_module/Kconfig
```kconfig
# SPDX-License-Identifier: Apache-2.0

config AXC3000_HYPERRAM
	bool "AXC3000 onboard HyperRAM"
	default $(dt_nodelabel_enabled,hyperram)
	help
	  Waits at boot for the HyperRAM's calibration (hyperram_axi holds the
	  bus until then) and puts a k_heap, hyperram_heap, on the part of the
	  'hyperram' devicetree memory region the linker does not use.
	  Needs zephyr_overlays/niosv_g_hyperram.overlay, and
	  CONFIG_SYS_HEAP_AUTO=y (or _BIG_ONLY): the 256 KB on-chip RAM makes
	  Zephyr default to small-only heaps, capped at 256 KB.

config AXC3000_HYPERRAM_CALIBRATION_TIMEOUT_MS
	int "Longest wait for the HyperRAM calibration"
	default 1000
	depends on AXC3000_HYPERRAM

config AXC3000_HYPERRAM_WAIT
	bool "Wait for the HyperRAM's calibration at boot (no heap)"
	depends on !AXC3000_HYPERRAM
	help
	  For MCUboot: it copies the application into the HyperRAM right
	  after a cold boot. Waits until hw/'s calibration reports done
	  (src/hyperram_wait.c); AXC3000_HYPERRAM does that and more for
	  applications.

config AXC3000_HYPERRAM_WAIT_TIMEOUT_MS
	int "Longest wait for the HyperRAM calibration"
	default 1000
	depends on AXC3000_HYPERRAM_WAIT

config UART_AXC3000
	bool "AXC3000 UART with FIFOs"
	default y
	depends on SERIAL && DT_HAS_AXC3000_UART_FIFO_ENABLED
	select SERIAL_HAS_DRIVER
	select SERIAL_SUPPORT_INTERRUPT
	help
	  The UART with RX/TX FIFOs of niosv_zephyr/hw/uart/uart_axi4lite.vhd
	  (the FTDI serial port, up to 4.8 MBaud).

config FLASH_AXC3000_SDM_QSPI
	bool "AXC3000 QSPI configuration flash through the SDM mailbox"
	default y
	depends on FLASH && DT_HAS_AXC3000_SDM_QSPI_ENABLED
	select FLASH_HAS_DRIVER_ENABLED
	select FLASH_HAS_EXPLICIT_ERASE
	select FLASH_HAS_PAGE_LAYOUT
	help
	  The board's QSPI flash through the Mailbox Client IP
	  (niosv_zephyr/hw mbox0, 0xC0000): read, write, erase.

config UART_AXC3000_JTAG
	bool "JTAG UART console that does not hang without a host"
	default y
	depends on SERIAL && DT_HAS_AXC3000_JTAG_UART_ENABLED
	select SERIAL_HAS_DRIVER
	help
	  Replaces Zephyr's altr,jtag-uart driver (which waits for FIFO room
	  with interrupts locked and no timeout): drops characters while no
	  host reads the JTAG UART. The board overlay sets uart0's compatible
	  to axc3000,jtag-uart.

config AXC3000_SDM_REBOOT
	bool "Reboot by reconfiguring the FPGA from the running bitstream"
	default y
	depends on FLASH_AXC3000_SDM_QSPI && REBOOT
	help
	  sys_reboot() asks the SDM to reconfigure the device from the
	  bitstream image that is running (RSU), which reloads MCUboot into the
	  on-chip RAM - except a warm reboot with AXC3000_WARM_REBOOT.

config AXC3000_WARM_REBOOT
	bool "Warm reboot: restart MCUboot without reconfiguring the FPGA"
	default y
	depends on AXC3000_SDM_REBOOT || MCUBOOT
	depends on $(dt_nodelabel_enabled,axc3000_boot_flags)
	help
	  MCUboot runs as an XIP image from the bottom 64 KB of the on-chip
	  RAM (mcuboot/mcuboot.overlay) and sets the boot flags
	  (niosv_g_bootinfo.overlay); sys_reboot(SYS_REBOOT_WARM) - mcumgr's
	  reset - then jumps back to it instead of reconfiguring the FPGA
	  (src/warm_reboot.c). Cold reboots still reconfigure.

config AXC3000_NIOSV_CACHE
	bool "Nios V/g data cache (a hardware variant with dataCacheSize > 0)"
	select CPU_HAS_DCACHE
	select CPU_HAS_ICACHE
	select SOC_PREP_HOOK
	help
	  The Nios V/g caches for Zephyr's cache API (drivers/cache/
	  cache_niosv.c; also set CONFIG_EXTERNAL_CACHE=y and
	  CONFIG_CACHE_MANAGEMENT=y): the write-back data cache flushed or
	  invalidated by index (the whole cache) or address (Zicbom), the
	  instruction cache invalidated with fence.i. Flushes the data cache
	  at the start (soc_prep_hook) and before a warm reboot.

config AXC3000_NIOSV_DCACHE_SIZE
	int "Nios V/g data cache size (bytes)"
	default 8192
	depends on AXC3000_NIOSV_CACHE
	help
	  cpu0's dataCacheSize in hw/build_niosv_system.tcl.

config AXC3000_LIBRSU
	bool "Altera's uniLibRSU (Remote System Update) on the QSPI flash"
	depends on FLASH_AXC3000_SDM_QSPI
	select CRC
	help
	  Altera's uniLibRSU (lib/unilibrsu, MIT-0): program FPGA application
	  images into the RSU flash slots (P1, P2), make one the highest
	  priority, read the RSU status. <libRSU.h>; librsu_init(NULL).
	  It writes only the RSU tables and P1/P2 (devicetree partitions).
	  It uses malloc: give it a heap (COMMON_LIBC_MALLOC_ARENA_SIZE).

if AXC3000_LIBRSU
module = UNILIBRSU
module-str = uniLibRSU
source "subsys/logging/Kconfig.template.log_config"
endif

config AXC3000_RSU_MGMT
	bool "FPGA bitstream updates over mcumgr (command group 64)"
	depends on AXC3000_LIBRSU && MCUMGR && AXC3000_HYPERRAM
	help
	  Upload an RSU application image (hw/flash/make_flash_images.sh's
	  application.rpd) over SMP into a HyperRAM buffer, program it into an
	  RSU slot with libRSU and make it the highest priority
	  (mcuboot/update_bitstream.py). Needs
	  MCUMGR_TRANSPORT_WORKQUEUE_STACK_SIZE >= 12288 (libRSU's image
	  blocks live on that stack).

DT_COMPAT_AXC3000_PR_CONTROLLER := axc3000,pr-controller

config AXC3000_PR
	bool "Partial reconfiguration of the PR_DEMO hardware's PR region"
	default $(dt_compat_enabled,$(DT_COMPAT_AXC3000_PR_CONTROLLER))
	help
	  axc3000_pr_program() (<axc3000/pr.h>, src/pr.c): programs a PR
	  bitstream (a persona, hw/pr/build_personas.sh's *.blinker.rbf)
	  through Altera's PR Controller IP. Needs
	  zephyr_overlays/niosv_g_pr.overlay.

config AXC3000_PR_MGMT
	bool "Partial reconfiguration over mcumgr (command 4 of group 64)"
	default y
	depends on AXC3000_RSU_MGMT && AXC3000_PR
	help
	  Program a persona uploaded with rsu_mgmt's upload command
	  (mcuboot/update_bitstream.py pr).
```

## niosv_zephyr/zephyr_module/dts/bindings/flash_controller/axc3000,sdm-qspi.yaml
```yaml
# SPDX-License-Identifier: Apache-2.0

description: |
  The AXC3000's QSPI configuration flash, reached through the SDM mailbox
  (the Mailbox Client IP at reg). Its child "flash@0" (soc-nv-flash) gives
  the flash size and holds the partitions.

compatible: "axc3000,sdm-qspi"

include: flash-controller.yaml
```

## niosv_zephyr/zephyr_module/dts/bindings/fpga/axc3000,pr-controller.yaml
```yaml
# SPDX-License-Identifier: Apache-2.0

description: |
  The PR_DEMO hardware's partial reconfiguration (niosv_zephyr/hw
  build_niosv_system.tcl): reg[0] Altera's Partial Reconfiguration
  Controller IP (pr0, Avalon-MM, 32-bit data), reg[1] pio_pr_ctrl (bit 0
  freezes the PR region's outputs, bit 1 holds it in reset).

compatible: "axc3000,pr-controller"

include: base.yaml

properties:
  reg:
    required: true
```

## niosv_zephyr/zephyr_module/dts/bindings/serial/axc3000,jtag-uart.yaml
```yaml
# SPDX-License-Identifier: Apache-2.0

description: |
  The Altera JTAG UART as a console that drops characters while no host
  reads it, instead of hanging (zephyr_module/drivers/serial/
  uart_axc3000_jtag.c). Polled only.

compatible: "axc3000,jtag-uart"

include: uart-controller.yaml

properties:
  reg:
    required: true
```

## niosv_zephyr/zephyr_module/dts/bindings/serial/axc3000,uart-fifo.yaml
```yaml
# SPDX-License-Identifier: Apache-2.0

description: |
  AXC3000 UART with RX/TX FIFOs (niosv_zephyr/hw/uart/uart_axi4lite.vhd):
  8N1, a fractional bit time (any baud rate up to clock / 4), interrupts on
  an RX level, an RX idle timeout and TX space.

compatible: "axc3000,uart-fifo"

include: uart-controller.yaml

properties:
  reg:
    required: true

  clock-frequency:
    type: int
    description: |
      The UART's clock (the bus clock), Hz. Default: the CPU's
      clock-frequency - the UART is in the Nios V/g clock domain.

  current-speed:
    required: true

  fifo-size:
    type: int
    default: 2048
    description: Depth of each FIFO, bytes (the hardware's g_fifo_depth_log2).
```
