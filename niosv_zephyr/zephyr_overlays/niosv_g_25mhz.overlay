/*
 * niosv_zephyr/hw's Platform Designer system clocks the Nios V/g core
 * straight off the board's 25 MHz oscillator (no PLL yet - see
 * hw/build_niosv_system.tcl) instead of the stock niosv_g.dts's assumed
 * 50 MHz. SYS_CLOCK_HW_CYCLES_PER_SEC (and so the mtimer tick rate) comes
 * straight from this property - see
 * soc/intel/intel_niosv/niosv/Kconfig.defconfig.series.
 */
&cpu0 {
	clock-frequency = <25000000>;
};
