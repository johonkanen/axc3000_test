/*
 * MCUboot on the AXC3000 Nios V/g: runs from on-chip RAM, finds the
 * application in the QSPI flash's slots (through the SDM mailbox), copies the
 * newest valid one into the HyperRAM (RAM-load) and starts it; serial
 * recovery (mcumgr / SMP) on the 12 MBaud FTDI UART.
 */

/* The on-chip RAM (with zephyr_overlays/niosv_g_bootinfo.overlay at the top):
 *
 *   0x00000  64 KB  MCUboot's "ROM": chosen zephyr,flash, so with CONFIG_XIP
 *                   its code, read-only data and .data's initial values are
 *                   linked here (the bitstream's RAM contents; the CPU's
 *                   reset vector is at 0). Nothing writes it at run time, so
 *                   MCUboot can be started again without reconfiguring the
 *                   FPGA - a warm reboot (zephyr_module/src/warm_reboot.c).
 *   0x10000         sram0: MCUboot's RAM (.data copied, .bss cleared at
 *                   every start) - the application's RAM once it runs
 */
&sram0 {
	reg = <0x10000 0x2fef0>;
};

/ {
	chosen {
		zephyr,flash = &mcuboot_rom;
		zephyr,flash-controller = &qspi;
		zephyr,uart-mcumgr = &uart1;
	};

	mcuboot_rom: memory@0 {
		compatible = "soc-nv-flash";
		reg = <0x0 0x10000>;
	};
};
